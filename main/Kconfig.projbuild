## main/Kconfig.projbuild
```kconfig
# put here your custom config value
menu "Sdrone Configuration"

  menu "Wifi Configuration"
    config ESP_WIFI_SSID
      string "WiFi SSID"
      default "myssid"
      help
        SSID (network name) for the example to connect to.

    config ESP_WIFI_PASSWORD
      string "WiFi Password"
      default "mypassword"
      help
        WiFi password (WPA or WPA2) for the example to use.
    config ESP_WIFI_CHANNEL
      int "WiFi Channel"
      range 1 13
      default 1
      help
        WiFi channel (network channel) for the example to use.

    config ESP_MAX_STA_CONN
      int "Maximal STA connections"
      default 4
      help
        Max number of the STA connects to AP.
  endmenu

  menu "RC Configuration"
    choice ESP_RC_PROTOCOL
      prompt "RC Protocol"
      default ESP_RC_PROTOCOL_IBUS
      config ESP_RC_PROTOCOL_IBUS
        bool "I-BUS"
      config ESP_RC_PROTOCOL_PPM
        bool "PPM"
    endchoice
  endmenu
endmenu
```
